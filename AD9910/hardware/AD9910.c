#include "stm32f4xx.h"
#include "AD9910.h"
#include "sys.h"
#include "main.h"
#include "stdio.h"

uchar cfr1[]={0x00,0x40,0x00,0x00};       												//cfr1控制字
uchar cfr2[]={0x01,0x00,0x00,0x00};       												//cfr2控制字
const uchar cfr3[]={0x05,0x0F,0x41,0x32};       									//cfr3控制字  40M输入  25倍频  VC0=101   ICP=001;
uchar profile11[]={0x3f,0xff,0x00,0x00,0x25,0x09,0x7b,0x42};      //profile1控制字 0x25,0x09,0x7b,0x42
                  //01振幅控制 23相位控制 4567频率调谐字

uchar drgparameter[20]={0x00}; //DRG参数
uchar ramprofile0[8] = {0x00}; //ramprofile0控制字

const unsigned char ramdata_Square[4096];


/////三角波 波形数据，1024个点，14DAC值，最大16383
const u32 RAM_TRIG_WAVE[]=																																														
{
0,31,63,95,127,159,191,223,255,287,319,351,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0,
};


/////方波 波形数据，1024个点，14DAC值，最大16383
const u32 RAM_SQUARE_WAVE[]=																																														
{
0,0,0,0,0,0,0,0,0,0,0,0,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16383,
};


/////SINC波 波形数据，1024个点，14DAC值，最大16383
const u32 RAM_SINC_WAVE[]=																																														
{
2924,2897,2871,2844,2818,2792,2766,2740,2715,2690,2666,2642,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2924,
};

//======================ad9910初始化程序===============================
void Init_ad9910(void)
{	
	AD9910_PWR_L;//软件拉低
	//选中profile0
	PROFILE2_L;
	PROFILE1_L;
	PROFILE0_L;
	DRCTL_L;
	DRHOLD_L;
	MAS_REST_H; 
	HAL_Delay(5);  
	MAS_REST_L; 

	Txcfr();
} 
/************************************************************
** 函数名称 ：void txd_8bit(uchar txdat)
** 函数功能 ：AD9910串行口写入数据
** 入口参数 ：8位寄存器数据
** 出口参数 ：无
** 函数说明 ：无
**************************************************************/
void txd_8bit(uchar txdat)
{
	//第二个边沿下降沿读取数据
	uchar i,sbt;
	sbt=0x80;
	SCLK_L;
	for (i=0;i<8;i++)
	{
		if ((txdat & sbt)==0) 
			AD9910_SDIO_L; 
		else 
			AD9910_SDIO_H;
		SCLK_H;
		sbt=sbt>>1;
		SCLK_L;
	}
}  
/************************************************************
** 函数名称 ：void Txfrc(void))
** 函数功能 ：向AD9910芯片发送频率，幅度等相关控制数据，ad9910发送cfrx控制字程序
** 入口参数 ：无
** 出口参数 ：无
** 函数说明 ：无
**************************************************************/
void Txcfr(void)
{
	uchar m,k;

	CS_L;
	txd_8bit(0x00);    //发送CFR1控制字地址
	for (m=0;m<4;m++)
		txd_8bit(cfr1[m]); 
	CS_H;  
	for (k=0;k<10;k++);
	
	CS_L;
	txd_8bit(0x01);    //发送CFR2控制字地址
	for (m=0;m<4;m++)
		txd_8bit(cfr2[m]); 
	CS_H;  
	for (k=0;k<10;k++);

	CS_L;
	txd_8bit(0x02);    //发送CFR3控制字地址
	for (m=0;m<4;m++)
		txd_8bit(cfr3[m]); 
	CS_H;
	for (k=0;k<10;k++);

	UP_DAT_H;
	for(k=0;k<10;k++);
	UP_DAT_L;
	HAL_Delay(1);

	printf("Txcfr_over\n");
}         
/************************************************************
** 函数名称 ：void Txprofile(void)
** 函数功能 ：向AD9910芯片发送profile1,包含频率，幅度等相关控制数据
** 入口参数 ：无
** 出口参数 ：无
** 函数说明 ：无
**************************************************************/
void Txprofile(void)
{
	uchar m,k;

	CS_L;
	txd_8bit(0x0e);    //发送profile0控制字地址
	for (m=0;m<8;m++)
		txd_8bit(profile11[m]); 
	CS_H;
	for(k=0;k<10;k++);

	UP_DAT_H;
	for(k=0;k<10;k++);
	UP_DAT_L;
	HAL_Delay(1);
}         
/************************************************************
** 函数名称 ：void Freq_convert(ulong Freq)
** 函数功能 ：将需要的频率转换为对应的控制数据，保存进profile11并发送到芯片
** 入口参数 ：目标频率，单位Hz，范围0~420000000
** 出口参数 ：无
** 函数说明 ：无
**************************************************************/
void Freq_convert(ulong Freq)
{
	ulong Temp;
	if(Freq > 400000000)
		Freq = 400000000;
	Temp=(ulong)Freq*4.294967296; //将输入频率因子分为四个字节  4.294967296=(2^32)/1000000000 （1G 是内部时钟速度）
	profile11[7]=(uchar)Temp;
	profile11[6]=(uchar)(Temp>>8);
	profile11[5]=(uchar)(Temp>>16);
	profile11[4]=(uchar)(Temp>>24);
	Txprofile();
}
/************************************************************
** 函数名称 ：void Write_Amplitude(uint16_t Amp)
** 函数功能 ：将幅度控制数据保存到profile11并写入芯片
** 入口参数 ：幅度大学，范围1~800
** 出口参数 ：无
** 函数说明 ：14位幅度控制字，控制数据0~16383对应输出幅度0~800mV左右
**************************************************************/
void Write_Amplitude(uint16_t Amp)
{
	uint16_t temp = (uint16_t)(Amp/0.0488311);//幅度大小到幅度字处理，800/16383=0.0488311
	profile11[0] = (temp % 16384) >> 8;//低八位
  profile11[1] = (temp % 16384) & 0xff;
	Txprofile();
}
/************************************************************
** 函数名称 ：void Write_32bit(u32 dat)	
** 函数功能 ：AD9910串行口写入数据
** 入口参数 ：32位寄存器数据
** 出口参数 ：无
** 函数说明 ：无
**************************************************************/
void Write_32bit(u32 dat)																							
{
	u8 i ;
	u32 com;
	com = 0x80000000;
	SCLK_L;
	
	for(i=0; i < 32; i++)
	{
		if( (dat & com) == 0) 
			AD9910_SDIO_L;
		else 
			AD9910_SDIO_H;

		SCLK_H;
		com = com >> 1;
		SCLK_L;
	}
}
/************************************************************
** 函数名称 ：AD9910_RAM_WAVE_Set(AD9910_WAVE_ENUM wave)
** 函数功能 ：设置AD9910,RAM功能，向AD9910芯片内部RAM写入1024个点的波形数据，使模块可输出任意波形
							目前仅定义了三角波，方波，SINC波，三种波形数组
							用户也可自定义数组数据，使波形输出自己定义的任意波形(1024个数据，每个数据范围：0~16383)
** 入口参数 ：wave： TRIG_WAVE：三角波，SQUARE_WAVE：方波，SINC_WAVE：SINC波
** 出口参数 ：无
** 函数说明 ：RAM播放速率决定了输出波形的频率，输出频率与播放速率控制字参考以下说明
**************************************************************/
void AD9910_RAM_WAVE_Set(AD9910_WAVE_ENUM wave)
{
    int i;
    const u32 *srcWaveDta;
    u8 CFR1[] = {0x40, 0x40, 0x00, 0x00};			// RAM回放目的：幅度;;开启AD9910反Sinc滤波

//RAM_Profile0[1](高8位)  与  RAM_Profile0[2](低8位)共16位控制字M，决定了输出波形频率， 频率 = Fsysclk / (4*M) / 输出点数 = 1000000000 / (4*M) / 1024    1GHz = 10^9Hz
//u8 RAM_Profile0[] = {0x00, 0x00, 0x01, 0xff, 0xc0, 0x00, 0x00, 0x04};	//	地址步进率0X0001=    1,,从地址0回放到1023,共1024点，输出频率 = 1G / (4* 1) / 1024 = 244K Hz  // 连续循环模式RAM_PROx[7]=0x04
//u8 RAM_Profile0[] = {0x00, 0x00, 0x0A, 0xff, 0xc0, 0x00, 0x00, 0x04};	//	地址步进率0X000A=   10,,从地址0回放到1023,共1024点，输出频率 = 1G / (4*10) / 1024 =  24K Hz  // 连续循环模式RAM_PROx[7]=0x04
//u8 RAM_Profile0[] = {0x00, 0xFF, 0xFF, 0xff, 0xc0, 0x00, 0x00, 0x04};	//	地址步进率0XFFFF=65535,,从地址0回放到1023,共1024点，输出频率 = 1G / (4*65535) /1024 =3.7 Hz  // 连续循环模式RAM_PROx[7]=0x04
		u8 RAM_Profile0[] = {0x00, 0x00, 0xF4, 0xff, 0xc0, 0x00, 0x00, 0x04};	//	地址步进率0X00F4=244,从地址0回放到1023,共1024点，输出频率 = 1G / (4*244) /1024 =1k Hz  // 连续循环模式RAM_PROx[7]=0x04

    CS_L;
    txd_8bit(0x00);	// 将CFR1写入其寄存器0x00
    for(i = 0; i < 4; i++)
        txd_8bit(CFR1[i]);
    CS_H;


    CS_L;
    txd_8bit(0X0E);					//写寄存器RAM_Profile0
    for(i = 0; i < 8; i++)
    {
        txd_8bit(RAM_Profile0[i]);// 将RAM的起始和终止地址、地址步进率写入相应的寄存器  0x0e
    }
    CS_H;

    UP_DAT_L;// 更新AD9910
    UP_DAT_H;
    UP_DAT_L;

    CS_L;
    txd_8bit(0x16);

    switch((uint8_t)wave)		//将数据定位到wave控制的数据数组
    {
			case TRIG_WAVE:			srcWaveDta = RAM_TRIG_WAVE;        break;
			case SQUARE_WAVE:		srcWaveDta = RAM_SQUARE_WAVE;      break;
			case SINC_WAVE:			srcWaveDta = RAM_SINC_WAVE;        break;
			default:						srcWaveDta = RAM_TRIG_WAVE;        break;
    }
    for(i = 0; i < 1024; i++)
    {
        Write_32bit(srcWaveDta[i] << 18);//将三角波(或其他任意波形)的数据数组写入ram,32位寄存器，14位DAC值，数据左对齐，故左移18位
    }

    CS_H;
    CS_L;
    txd_8bit(0x00);																																// 将CFR1写入其地址0x00
    CFR1[0] |= 0X80; //使能RAM
    for(i = 0; i < 4; i++)
        txd_8bit(CFR1[i]);
    CS_H;

    UP_DAT_L;// 更新AD9910
    UP_DAT_H;
    UP_DAT_L;
}
/************************************************************
** 函数名称 ：void AD9910_DRG_FreInit_AutoSet(FunctionalState autoSweepEn)
** 函数功能 ：开启AD9910的数字斜坡模式DRG模式使能，使能数字斜坡控制频率，根据参数设置是否自动扫频
** 入口参数 ：autoSweepEn：ENABLE,使能自动扫频，
						此时无需外部控制,芯片自动从下限频率扫描到上限频率，再自动从上限频率扫描到下限频率，以此自动循环，实现上下双方向自动循环扫频

						autoSweepEn：DISABLE,关闭自动扫频，
						此时需外部引脚DRCTL脚控制扫频，不能自动扫频，扫频方向取决于DRCTL逻辑电平
						DRCTL引脚置高(3.3V)，AD9910从下限频率扫描到上限频率，扫描完成后保持在上限频率
						DRCTL引脚置低(  0V)，AD9910从上限频率扫描到下限频率，扫描完成后保持在下限频率

** 出口参数 ：无
** 函数说明 ：	autoSweepEn设置为ENABLE时，自动扫频，扫描完成自动换向，扫频速率可极高；
				autoSweepEn设置为DISABLE时，可由DRCTL脚程控或者外接线控，实现手动控制扫频
**************************************************************/
void AD9910_DRG_FreInit_AutoSet(FunctionalState autoSweepEn)
{
	u8 CFR1[]={0x00,0x40,0x00,0x00};																// 使能AD9910反Sinc滤波                             				
	u8 CFR2[]={0x00,0x48,0x08,0x20};																// SYNC_CLK使能，数字斜坡使能	  CFR2[21:20]= 00数字斜坡控制参数为频率(00:频率; 01:相位；1x：幅度)
	int j;
	
	
	if(autoSweepEn == ENABLE)
		CFR2[1] |= 0X06;
	
	CS_L;
	txd_8bit(0x00);																												// 将CFR1写入其地址0x00
	for(j=0;j<4;j++)
	{
		txd_8bit(CFR1[j]);
	}
	CS_H;	

	
	CS_L;
	txd_8bit(0x01);																												// 将CFR2写入其地址0x01
	for(j=0;j<4;j++)
	{
		txd_8bit(CFR2[j]);
	}
	CS_H;
	
	
	UP_DAT_L;																													// 更新AD9910
	UP_DAT_H;
	UP_DAT_L;
}
/************************************************************
** 函数名称 ：void AD9910_DRG_FrePara_Set(u32 lowFre, u32 upFre, u32 posStep, u32 negStep, u16 posRate, u16 negRate)
** 函数功能 ：按设定的频率上限，频率下限，上扫频步进，下扫频步进，及上扫频频点停留时间，下扫频频点停留时间，进行自动上下限循环扫频
** 入口参数 ：
							u32 lowFre:扫频下限频率 					范围：1Hz~450000000Hz(450M Hz)
							u32  upFre:扫频上限频率  					范围：1Hz~450000000Hz(450M Hz)
							u32 posStep：上扫频频率步进  				范围：1Hz~450000000Hz(450M Hz)
							u32 negStep：下扫频频率步进  				范围：1Hz~450000000Hz(450M Hz)
							u16 posRate：上扫频频点停留时间  			范围：0~65535
							u16 negRate：下扫频频点停留时间 			范围：0~65535
** 出口参数 ：无
** 函数说明 ：扫频时间计算
上扫频,频点与频点间停留时间 dt_P = 4*pos_rate / Fsysclk
上扫频,总扫描频点数 N_P = (upper_limit - lower_limit) / inc_step
上扫频,扫频时间 T_P = dt_P * N_P

下扫频,频点与频点间停留时间 dt_N = 4*neg_rate / Fsysclk
下扫频,总扫描频点数 N_N = (upper_limit - lower_limit) / dec_step
下扫频,扫频时间 T_N = dt_N * N_N

故，总扫频时间T_ALL = T_P + T_N
= (4*pos_rate / Fsysclk)*( (upper_limit - lower_limit) / inc_step ) + (4*neg_rate / Fsysclk)*( (upper_limit - lower_limit) / dec_step )

其中，Fsysclk在本示例代码工程中，被配置为1GHz， Fsysclk = 1000000000
如以下配置 AD9910_DRG_Freq_set(400000, 300000000, 1200000, 2200000, 100,300);

T_ALL = (4*100 / 1000000000)*((300000000 - 400000) / 1200000) + (4*300 / 1000000000)*((300000000 - 400000) / 2200000)
			= 263us

**************************************************************/
void AD9910_DRG_FrePara_Set(u32 lowFre, u32 upFre, u32 posStep, u32 negStep, u16 posRate, u16 negRate)
{
		u32 upper , lower ,dec, inc;
	u16 neg_rate , pos_rate;
	int i;
	
	u8 DRL[]={0x00,0x00,0x00,0x00,0x00,0x00,0x00,0x00};									// 数字斜坡限值
	u8 DRS[]={0x00,0x00,0x00,0x00,0x00,0x00,0x00,0x00};									// 数字斜坡步长
	u8 DRR[]={0x00,0x00,0x00,0x00};																			// 数字斜坡速率

	upper			=	(u32)  upFre*4.294967296;			// 频率字转换		4.294967296=(2^32)/1000000000
	lower			=	(u32) lowFre*4.294967296;
	dec				=	(u32)negStep*4.294967296;
	inc				=	(u32)posStep*4.294967296; 
	neg_rate	=  		negRate;										// 时间 dt_N = 4*neg_rate / Fsysclk
	pos_rate	=  		posRate;										// 时间 dt_P = 4*pos_rate / Fsysclk
	
	DRL[7]=(u8) lower;													//将上限下限频率、频率加减步进、频率加减速率写入u8数组方便写入相应的寄存器
	DRL[6]=(u8)(lower>>8);
	DRL[5]=(u8)(lower>>16);
	DRL[4]=(u8)(lower>>24);
	DRL[3]=(u8) upper;
	DRL[2]=(u8)(upper>>8);
	DRL[1]=(u8)(upper>>16);
	DRL[0]=(u8)(upper>>24);
	
	DRS[7]=(u8) inc;
	DRS[6]=(u8)(inc>>8);
	DRS[5]=(u8)(inc>>16);
	DRS[4]=(u8)(inc>>24);
	DRS[3]=(u8) dec;
	DRS[2]=(u8)(dec>>8);
	DRS[1]=(u8)(dec>>16);
	DRS[0]=(u8)(dec>>24);
	
	DRR[3]=(u8) pos_rate;
	DRR[2]=(u8)(pos_rate>>8);
	DRR[1]=(u8) neg_rate;
	DRR[0]=(u8)(neg_rate>>8);
	
	CS_L;												
	txd_8bit(0x0B);																												// 将数字斜坡限值存入 0x0B
	for(i=0;i<8;i++)
	{
		txd_8bit(DRL[i]);																								
	}
	CS_H;
	
	CS_L;											
	txd_8bit(0x0C);																												// 将数字斜坡步长存入 0x0C
	for(i=0;i<8;i++)
	{
		txd_8bit(DRS[i]);
	}
	CS_H;
	
	CS_L;												
	txd_8bit(0x0D);																												// 将数字斜坡速率存入 0x0D
	for(i=0;i<4;i++)
	{
		txd_8bit(DRR[i]);
	}
	CS_H;
	
	UP_DAT_L;																												// 更新AD9910
	UP_DAT_H;
	UP_DAT_L;
}






/*
//======================ad9910发送DRG参数程序==========================
void Txdrg(void)
{
	uchar m,k;

	CS_L;
	txd_8bit(0x0b);    //发送数字斜坡限制地址0x0b
	for (m=0;m<8;m++)
		txd_8bit(drgparameter[m]); 
	CS_H;
	for(k=0;k<10;k++);
	
	CS_L;
	txd_8bit(0x0c);    //发送数字斜坡步长地址0x0c
	for (m=8;m<16;m++)
		txd_8bit(drgparameter[m]); 
	CS_H;
	for(k=0;k<10;k++);
	
	CS_L;
	txd_8bit(0x0d);    //发送数字斜坡速率地址0x0d
	for (m=16;m<20;m++)
		txd_8bit(drgparameter[m]); 
	CS_H;
	for(k=0;k<10;k++);
	
	UP_DAT_H;
	for(k=0;k<10;k++);
	UP_DAT_L;
	HAL_Delay(1);
}         
//=====================================================================

//=====================扫频波参数设置和发送程序========================
void SweepFre(ulong SweepMinFre, ulong SweepMaxFre, ulong SweepStepFre, ulong SweepTime)
{
	ulong Temp1, Temp2, ITemp3, DTemp3, ITemp4, DTemp4;
	Temp1 = (ulong)SweepMinFre*4.294967296;
	if(SweepMaxFre > 400000000)
		SweepMaxFre = 400000000;
	Temp2 = (ulong)SweepMaxFre*4.294967296;
	if(SweepStepFre > 400000000)
		SweepStepFre = 400000000;
	ITemp3 = (ulong)SweepStepFre*4.294967296;
	DTemp3 = ITemp3;
	ITemp4 = (ulong)SweepTime/4; //1GHz/4, 单位：ns
	if(ITemp4 > 0xffff)
		ITemp4 = 0xffff;
	DTemp4 = ITemp4;
	
	//扫频上下限
	drgparameter[7]=(uchar)Temp1;
	drgparameter[6]=(uchar)(Temp1>>8);
	drgparameter[5]=(uchar)(Temp1>>16);
	drgparameter[4]=(uchar)(Temp1>>24);
	drgparameter[3]=(uchar)Temp2;
	drgparameter[2]=(uchar)(Temp2>>8);
	drgparameter[1]=(uchar)(Temp2>>16);
	drgparameter[0]=(uchar)(Temp2>>24);
	//频率步进（单位：Hz）
	drgparameter[15]=(uchar)ITemp3;
	drgparameter[14]=(uchar)(ITemp3>>8);
	drgparameter[13]=(uchar)(ITemp3>>16);
	drgparameter[12]=(uchar)(ITemp3>>24);
	drgparameter[11]=(uchar)DTemp3;
	drgparameter[10]=(uchar)(DTemp3>>8);
	drgparameter[9]=(uchar)(DTemp3>>16);
	drgparameter[8]=(uchar)(DTemp3>>24);
	//步进时间间隔（单位：us）
	drgparameter[19]=(uchar)ITemp4;
	drgparameter[18]=(uchar)(ITemp4>>8);
	drgparameter[17]=(uchar)DTemp4;
	drgparameter[16]=(uchar)(DTemp4>>8);
	//发送DRG参数
	Txdrg();
}
//=====================================================================

//=================ad9910发送ramprofile0控制字程序=====================
void Txramprofile(void)
{
	uchar m,k;

	CS_L;
	txd_8bit(0x0e);    //发送ramprofile0控制字地址
	for (m=0;m<8;m++)
		txd_8bit(ramprofile0[m]); 
	CS_H;
	for(k=0;k<10;k++);

	UP_DAT_H;
	for(k=0;k<10;k++);
	UP_DAT_L;
	HAL_Delay(1);
}         
//=====================================================================

//=======================ad9910发送ramdata程序=========================
void Txramdata(void)
{
	uint m,k;

	CS_L;
	txd_8bit(0x16);    //发送ram控制字地址
	for (m=0; m<4096; m++)
		txd_8bit(ramdata_Square[m]); 
	CS_H;
	for(k=0;k<10;k++);

	UP_DAT_H;
	for(k=0;k<10;k++);
	UP_DAT_L;
	HAL_Delay(1);
}         
//=====================================================================

//=======================方波参数设置和发送程序========================
void Square_wave(uint Sample_interval)//方波
{
	ulong Temp;
	Temp = Sample_interval/4; //1GHz/4, 采样间隔范围：4*(1~65536)ns
	if(Temp > 0xffff)
		Temp = 0xffff;
	ramprofile0[7] = 0x24;
	ramprofile0[6] = 0x00;
	ramprofile0[5] = 0x00;
	ramprofile0[4] = 0xc0;
	ramprofile0[3] = 0x0f;
	ramprofile0[2] = (uchar)Temp;
	ramprofile0[1] = (uchar)(Temp>>8);
	ramprofile0[0] = 0x00;
	Txramprofile();

	Txramdata();	
 }
*/

