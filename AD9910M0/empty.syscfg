/**
 * @cliArgs --device "MSPM0G350X" --part "Default" --package "LQFP-64(PM)" --product "mspm0_sdk@2.04.00.06"
 * @versions {"tool":"1.22.0+3893"}
 */

/**
 * Import the modules used in this configuration.
 */
const GPIO   = scripting.addModule("/ti/driverlib/GPIO", {}, false);
const GPIO1  = GPIO.addInstance();
const SYSCTL = scripting.addModule("/ti/driverlib/SYSCTL");

/**
 * Write custom configuration values to the imported modules.
 */
GPIO1.$name                           = "AD9910";
GPIO1.associatedPins.create(13);
GPIO1.associatedPins[0].$name         = "PWR";
GPIO1.associatedPins[0].assignedPort  = "PORTA";
GPIO1.associatedPins[0].assignedPin   = "13";
GPIO1.associatedPins[1].$name         = "SDIO";
GPIO1.associatedPins[1].assignedPort  = "PORTA";
GPIO1.associatedPins[1].assignedPin   = "12";
GPIO1.associatedPins[2].$name         = "DRHOLD";
GPIO1.associatedPins[2].assignedPort  = "PORTA";
GPIO1.associatedPins[2].assignedPin   = "11";
GPIO1.associatedPins[3].$name         = "DROVER";
GPIO1.associatedPins[3].assignedPort  = "PORTA";
GPIO1.associatedPins[3].assignedPin   = "10";
GPIO1.associatedPins[4].$name         = "UP_DAT";
GPIO1.associatedPins[4].assignedPort  = "PORTB";
GPIO1.associatedPins[4].assignedPin   = "13";
GPIO1.associatedPins[5].$name         = "PROFILE1";
GPIO1.associatedPins[5].assignedPort  = "PORTB";
GPIO1.associatedPins[5].assignedPin   = "20";
GPIO1.associatedPins[6].$name         = "PROFILE2";
GPIO1.associatedPins[6].assignedPort  = "PORTA";
GPIO1.associatedPins[6].assignedPin   = "31";
GPIO1.associatedPins[7].$name         = "PROFILE3";
GPIO1.associatedPins[7].assignedPort  = "PORTA";
GPIO1.associatedPins[7].assignedPin   = "28";
GPIO1.associatedPins[8].$name         = "MAS_REST";
GPIO1.associatedPins[8].assignedPort  = "PORTB";
GPIO1.associatedPins[8].assignedPin   = "12";
GPIO1.associatedPins[9].$name         = "SCLK";
GPIO1.associatedPins[9].assignedPort  = "PORTB";
GPIO1.associatedPins[9].assignedPin   = "17";
GPIO1.associatedPins[10].$name        = "DRCTL";
GPIO1.associatedPins[10].assignedPort = "PORTB";
GPIO1.associatedPins[10].assignedPin  = "15";
GPIO1.associatedPins[11].$name        = "OSK";
GPIO1.associatedPins[11].assignedPort = "PORTB";
GPIO1.associatedPins[11].assignedPin  = "8";
GPIO1.associatedPins[12].$name        = "CS";
GPIO1.associatedPins[12].assignedPort = "PORTB";
GPIO1.associatedPins[12].assignedPin  = "7";

const Board = scripting.addModule("/ti/driverlib/Board", {}, false);

SYSCTL.forceDefaultClkConfig = true;

/**
 * Pinmux solution for unlocked pins/peripherals. This ensures that minor changes to the automatic solver in a future
 * version of the tool will not impact the pinmux you originally saw.  These lines can be completely deleted in order to
 * re-solve from scratch.
 */
GPIO1.associatedPins[0].pin.$suggestSolution  = "PA13";
GPIO1.associatedPins[1].pin.$suggestSolution  = "PA12";
GPIO1.associatedPins[2].pin.$suggestSolution  = "PA11";
GPIO1.associatedPins[3].pin.$suggestSolution  = "PA10";
GPIO1.associatedPins[4].pin.$suggestSolution  = "PB13";
GPIO1.associatedPins[5].pin.$suggestSolution  = "PB20";
GPIO1.associatedPins[6].pin.$suggestSolution  = "PA31";
GPIO1.associatedPins[7].pin.$suggestSolution  = "PA28";
GPIO1.associatedPins[8].pin.$suggestSolution  = "PB12";
GPIO1.associatedPins[9].pin.$suggestSolution  = "PB17";
GPIO1.associatedPins[10].pin.$suggestSolution = "PB15";
GPIO1.associatedPins[11].pin.$suggestSolution = "PB8";
GPIO1.associatedPins[12].pin.$suggestSolution = "PB7";
Board.peripheral.$suggestSolution             = "DEBUGSS";
Board.peripheral.swclkPin.$suggestSolution    = "PA20";
Board.peripheral.swdioPin.$suggestSolution    = "PA19";
SYSCTL.peripheral.$suggestSolution            = "SYSCTL";
